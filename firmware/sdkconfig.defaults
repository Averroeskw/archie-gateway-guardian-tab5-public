## firmware/sdkconfig.defaults
```kconfig
CONFIG_PARTITION_TABLE_CUSTOM=y
CONFIG_PARTITION_TABLE_CUSTOM_FILENAME="partitions.csv"
CONFIG_PARTITION_TABLE_FILENAME="partitions.csv"
CONFIG_ESPTOOLPY_FLASHSIZE_16MB=y
CONFIG_ESPTOOLPY_FLASHSIZE="16MB"
CONFIG_IDF_EXPERIMENTAL_FEATURES=y
CONFIG_SPIRAM=y
CONFIG_SPIRAM_MODE_HEX=y
CONFIG_SPIRAM_SPEED_200M=y
CONFIG_SPIRAM_SPEED=200
CONFIG_SPIRAM_BOOT_INIT=y
CONFIG_SPIRAM_PRE_CONFIGURE_MEMORY_PROTECTION=y
CONFIG_SPIRAM_USE_MALLOC=y
CONFIG_SPIRAM_MEMTEST=y
CONFIG_SPIRAM_MALLOC_ALWAYSINTERNAL=16384
CONFIG_SPIRAM_TRY_ALLOCATE_WIFI_LWIP=y
CONFIG_SPIRAM_MALLOC_RESERVE_INTERNAL=150000
CONFIG_FREERTOS_TASK_CREATE_ALLOW_EXT_MEM=y
CONFIG_ESP_HOSTED_MEMPOOL_PREFER_SPIRAM=y

# SD card profile filenames exceed FAT 8.3 names.
CONFIG_FATFS_LFN_HEAP=y

# Monospace bitmap font available as a fallback.
CONFIG_LV_FONT_UNSCII_8=y

# M5Stack Tab5 ESP32-P4 <-> ESP32-C6 SDIO wiring.
# The generic ESP-hosted P4 defaults use the wrong pins for Tab5.
CONFIG_ESP_HOSTED_P4_DEV_BOARD_NONE=y
CONFIG_ESP_HOSTED_SDIO_SLOT_1=y
CONFIG_ESP_HOSTED_SDIO_SLOT=1
CONFIG_ESP_HOSTED_SDIO_4_BIT_BUS=y
CONFIG_ESP_HOSTED_SDIO_BUS_WIDTH=4
CONFIG_ESP_HOSTED_PRIV_SDIO_PIN_CMD_SLOT_1=13
CONFIG_ESP_HOSTED_PRIV_SDIO_PIN_CLK_SLOT_1=12
CONFIG_ESP_HOSTED_PRIV_SDIO_PIN_D0_SLOT_1=11
CONFIG_ESP_HOSTED_PRIV_SDIO_PIN_D1_4BIT_BUS_SLOT_1=10
CONFIG_ESP_HOSTED_PRIV_SDIO_PIN_D2_4BIT_BUS_SLOT_1=9
CONFIG_ESP_HOSTED_PRIV_SDIO_PIN_D3_4BIT_BUS_SLOT_1=8
CONFIG_ESP_HOSTED_SDIO_GPIO_RESET_SLAVE=15
CONFIG_ESP_HOSTED_GPIO_SLAVE_RESET_SLAVE=15

# OTA A/B slots + crash forensics: panics persist a backtrace into the
# coredump partition so failures are debuggable without a live monitor.
# Enabling this also grows the generated FREERTOS_ISR_STACKSIZE (1536->2096)
# to fit the crash-capture path; that sdkconfig delta is expected.
CONFIG_ESP_COREDUMP_ENABLE_TO_FLASH=y
CONFIG_ESP_COREDUMP_DATA_FORMAT_ELF=y
CONFIG_ESP_COREDUMP_CHECKSUM_CRC32=y

# Larger fonts for the console (wordmark, headings).
CONFIG_LV_FONT_MONTSERRAT_18=y
CONFIG_LV_FONT_MONTSERRAT_24=y
CONFIG_LV_FONT_MONTSERRAT_28=y

# IDF 5.4.2 predates Espressif's ESP32-P4 PPA SRM workaround (DIG-734), so the
# UI deliberately uses the proven full-frame PSRAM software-rotation pipeline.
# Keep the performance compiler profile without enabling the affected PPA path.
# CONFIG_LVGL_PORT_ENABLE_PPA is not set
# CONFIG_LV_USE_PPA is not set
CONFIG_COMPILER_OPTIMIZATION_PERF=y
```
